## Kconfig
```kconfig
config ZMK_BEHAVIOR_EYELASH_DFU
    bool "Eyelash nRF52832 Bluetooth DFU entry"
    default y
    depends on SOC_NRF52832_QFAA && DT_HAS_EYELASH_BEHAVIOR_DFU_ENABLED
    help
      Request the paired Adafruit S132 bootloader using GPREGRET 0xA8.
```

## boards/eyelash/eyelash_numpad/Kconfig.eyelash_numpad
```kconfig
config BOARD_EYELASH_NUMPAD
    select SOC_NRF52832_QFAA
    select ZMK_BOARD_COMPAT
```

## config/west.yml
```yaml
manifest:
  remotes:
    - name: cormoran
      url-base: https://github.com/cormoran
  projects:
    - name: zmk
      remote: cormoran
      revision: e5c9b6915b56801193e359dd9bad4a167ce0d1b8
      import: app/west.yml
    - name: zmk-feature-custom-settings
      remote: cormoran
      revision: c6a7fef3a3be3d3ace5de9a4b0628c6418cd1f3f
    - name: zmk-feature-runtime-macro
      remote: cormoran
      revision: 38530962eb7061b60efcb98e84585cfb1f0cb6de
    - name: zmk-feature-runtime-tapdance
      remote: cormoran
      revision: 3ed2c36ed94b16601eeba2ed39a27cc93e9a53ee
    - name: zmk-feature-runtime-combo
      remote: cormoran
      revision: d9490e7b5d41c516221d131241009e81740efcee
    - name: zmk-module-settings-rpc
      remote: cormoran
      revision: 78f86df9e6c5edaf57bef3ccbd7f360cfdf49291
    - name: zmk-feature-device-info
      remote: cormoran
      revision: 8cedd2dd9f04e19ea5a17b94914dd47a09d8db11
  self:
    path: config
```

## dts/bindings/behaviors/eyelash,behavior-dfu.yaml
```yaml
description: Enter the Eyelash nRF52832 bootloader in Bluetooth DFU mode
compatible: "eyelash,behavior-dfu"
include: zero_param.yaml
```
