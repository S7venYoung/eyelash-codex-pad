/ {
    behaviors {
        eyelash_dfu: eyelash_dfu {
            compatible = "eyelash,behavior-dfu";
            #binding-cells = <0>;
            display-name = "Bluetooth DFU";
        };
    };
};
